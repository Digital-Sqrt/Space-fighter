;
; File Name: cyfitteriar.inc
; 
; PSoC Creator  4.4
;
; Description:
; 
;
;-------------------------------------------------------------------------------
; Copyright (c) 2007-2020 Cypress Semiconductor.  All rights reserved.
; You may use this file only in accordance with the license, terms, conditions, 
; disclaimers, and limitations in the end user license agreement accompanying 
; the software package with which this file was provided.
;-------------------------------------------------------------------------------

#ifndef INCLUDED_CYFITTERIAR_INC
#define INCLUDED_CYFITTERIAR_INC
    INCLUDE cydeviceiar.inc
    INCLUDE cydeviceiar_trm.inc

/* I2C_CLK */
I2C_CLK__CFG0 EQU CYREG_CLKDIST_DCFG0_CFG0
I2C_CLK__CFG1 EQU CYREG_CLKDIST_DCFG0_CFG1
I2C_CLK__CFG2 EQU CYREG_CLKDIST_DCFG0_CFG2
I2C_CLK__CFG2_SRC_SEL_MASK EQU 0x07
I2C_CLK__INDEX EQU 0x00
I2C_CLK__PM_ACT_CFG EQU CYREG_PM_ACT_CFG2
I2C_CLK__PM_ACT_MSK EQU 0x01
I2C_CLK__PM_STBY_CFG EQU CYREG_PM_STBY_CFG2
I2C_CLK__PM_STBY_MSK EQU 0x01

/* SPI_CLK */
SPI_CLK__0__INTTYPE EQU CYREG_PICU1_INTTYPE7
SPI_CLK__0__MASK EQU 0x80
SPI_CLK__0__PC EQU CYREG_PRT1_PC7
SPI_CLK__0__PORT EQU 1
SPI_CLK__0__SHIFT EQU 7
SPI_CLK__AG EQU CYREG_PRT1_AG
SPI_CLK__AMUX EQU CYREG_PRT1_AMUX
SPI_CLK__BIE EQU CYREG_PRT1_BIE
SPI_CLK__BIT_MASK EQU CYREG_PRT1_BIT_MASK
SPI_CLK__BYP EQU CYREG_PRT1_BYP
SPI_CLK__CTL EQU CYREG_PRT1_CTL
SPI_CLK__DM0 EQU CYREG_PRT1_DM0
SPI_CLK__DM1 EQU CYREG_PRT1_DM1
SPI_CLK__DM2 EQU CYREG_PRT1_DM2
SPI_CLK__DR EQU CYREG_PRT1_DR
SPI_CLK__INP_DIS EQU CYREG_PRT1_INP_DIS
SPI_CLK__INTTYPE_BASE EQU CYDEV_PICU_INTTYPE_PICU1_BASE
SPI_CLK__LCD_COM_SEG EQU CYREG_PRT1_LCD_COM_SEG
SPI_CLK__LCD_EN EQU CYREG_PRT1_LCD_EN
SPI_CLK__MASK EQU 0x80
SPI_CLK__PORT EQU 1
SPI_CLK__PRT EQU CYREG_PRT1_PRT
SPI_CLK__PRTDSI__CAPS_SEL EQU CYREG_PRT1_CAPS_SEL
SPI_CLK__PRTDSI__DBL_SYNC_IN EQU CYREG_PRT1_DBL_SYNC_IN
SPI_CLK__PRTDSI__OE_SEL0 EQU CYREG_PRT1_OE_SEL0
SPI_CLK__PRTDSI__OE_SEL1 EQU CYREG_PRT1_OE_SEL1
SPI_CLK__PRTDSI__OUT_SEL0 EQU CYREG_PRT1_OUT_SEL0
SPI_CLK__PRTDSI__OUT_SEL1 EQU CYREG_PRT1_OUT_SEL1
SPI_CLK__PRTDSI__SYNC_OUT EQU CYREG_PRT1_SYNC_OUT
SPI_CLK__PS EQU CYREG_PRT1_PS
SPI_CLK__SHIFT EQU 7
SPI_CLK__SLW EQU CYREG_PRT1_SLW

/* SPI_DATA */
SPI_DATA__0__INTTYPE EQU CYREG_PICU1_INTTYPE6
SPI_DATA__0__MASK EQU 0x40
SPI_DATA__0__PC EQU CYREG_PRT1_PC6
SPI_DATA__0__PORT EQU 1
SPI_DATA__0__SHIFT EQU 6
SPI_DATA__AG EQU CYREG_PRT1_AG
SPI_DATA__AMUX EQU CYREG_PRT1_AMUX
SPI_DATA__BIE EQU CYREG_PRT1_BIE
SPI_DATA__BIT_MASK EQU CYREG_PRT1_BIT_MASK
SPI_DATA__BYP EQU CYREG_PRT1_BYP
SPI_DATA__CTL EQU CYREG_PRT1_CTL
SPI_DATA__DM0 EQU CYREG_PRT1_DM0
SPI_DATA__DM1 EQU CYREG_PRT1_DM1
SPI_DATA__DM2 EQU CYREG_PRT1_DM2
SPI_DATA__DR EQU CYREG_PRT1_DR
SPI_DATA__INP_DIS EQU CYREG_PRT1_INP_DIS
SPI_DATA__INTTYPE_BASE EQU CYDEV_PICU_INTTYPE_PICU1_BASE
SPI_DATA__LCD_COM_SEG EQU CYREG_PRT1_LCD_COM_SEG
SPI_DATA__LCD_EN EQU CYREG_PRT1_LCD_EN
SPI_DATA__MASK EQU 0x40
SPI_DATA__PORT EQU 1
SPI_DATA__PRT EQU CYREG_PRT1_PRT
SPI_DATA__PRTDSI__CAPS_SEL EQU CYREG_PRT1_CAPS_SEL
SPI_DATA__PRTDSI__DBL_SYNC_IN EQU CYREG_PRT1_DBL_SYNC_IN
SPI_DATA__PRTDSI__OE_SEL0 EQU CYREG_PRT1_OE_SEL0
SPI_DATA__PRTDSI__OE_SEL1 EQU CYREG_PRT1_OE_SEL1
SPI_DATA__PRTDSI__OUT_SEL0 EQU CYREG_PRT1_OUT_SEL0
SPI_DATA__PRTDSI__OUT_SEL1 EQU CYREG_PRT1_OUT_SEL1
SPI_DATA__PRTDSI__SYNC_OUT EQU CYREG_PRT1_SYNC_OUT
SPI_DATA__PS EQU CYREG_PRT1_PS
SPI_DATA__SHIFT EQU 6
SPI_DATA__SLW EQU CYREG_PRT1_SLW

/* Frame_CLK */
Frame_CLK__CFG0 EQU CYREG_CLKDIST_DCFG1_CFG0
Frame_CLK__CFG1 EQU CYREG_CLKDIST_DCFG1_CFG1
Frame_CLK__CFG2 EQU CYREG_CLKDIST_DCFG1_CFG2
Frame_CLK__CFG2_SRC_SEL_MASK EQU 0x07
Frame_CLK__INDEX EQU 0x01
Frame_CLK__PM_ACT_CFG EQU CYREG_PM_ACT_CFG2
Frame_CLK__PM_ACT_MSK EQU 0x02
Frame_CLK__PM_STBY_CFG EQU CYREG_PM_STBY_CFG2
Frame_CLK__PM_STBY_MSK EQU 0x02

/* Frame_Timer */
Frame_Timer_TimerUDB_rstSts_stsreg__0__MASK EQU 0x01
Frame_Timer_TimerUDB_rstSts_stsreg__0__POS EQU 0
Frame_Timer_TimerUDB_rstSts_stsreg__16BIT_STATUS_AUX_CTL_REG EQU CYREG_B0_UDB11_12_ACTL
Frame_Timer_TimerUDB_rstSts_stsreg__16BIT_STATUS_REG EQU CYREG_B0_UDB11_12_ST
Frame_Timer_TimerUDB_rstSts_stsreg__2__MASK EQU 0x04
Frame_Timer_TimerUDB_rstSts_stsreg__2__POS EQU 2
Frame_Timer_TimerUDB_rstSts_stsreg__3__MASK EQU 0x08
Frame_Timer_TimerUDB_rstSts_stsreg__3__POS EQU 3
Frame_Timer_TimerUDB_rstSts_stsreg__MASK EQU 0x0D
Frame_Timer_TimerUDB_rstSts_stsreg__MASK_REG EQU CYREG_B0_UDB11_MSK
Frame_Timer_TimerUDB_rstSts_stsreg__STATUS_AUX_CTL_REG EQU CYREG_B0_UDB11_ACTL
Frame_Timer_TimerUDB_rstSts_stsreg__STATUS_REG EQU CYREG_B0_UDB11_ST
Frame_Timer_TimerUDB_sCTRLReg_SyncCtl_ctrlreg__16BIT_CONTROL_AUX_CTL_REG EQU CYREG_B0_UDB10_11_ACTL
Frame_Timer_TimerUDB_sCTRLReg_SyncCtl_ctrlreg__16BIT_CONTROL_CONTROL_REG EQU CYREG_B0_UDB10_11_CTL
Frame_Timer_TimerUDB_sCTRLReg_SyncCtl_ctrlreg__16BIT_CONTROL_COUNT_REG EQU CYREG_B0_UDB10_11_CTL
Frame_Timer_TimerUDB_sCTRLReg_SyncCtl_ctrlreg__16BIT_COUNT_CONTROL_REG EQU CYREG_B0_UDB10_11_CTL
Frame_Timer_TimerUDB_sCTRLReg_SyncCtl_ctrlreg__16BIT_COUNT_COUNT_REG EQU CYREG_B0_UDB10_11_CTL
Frame_Timer_TimerUDB_sCTRLReg_SyncCtl_ctrlreg__16BIT_MASK_MASK_REG EQU CYREG_B0_UDB10_11_MSK
Frame_Timer_TimerUDB_sCTRLReg_SyncCtl_ctrlreg__16BIT_MASK_PERIOD_REG EQU CYREG_B0_UDB10_11_MSK
Frame_Timer_TimerUDB_sCTRLReg_SyncCtl_ctrlreg__16BIT_PERIOD_MASK_REG EQU CYREG_B0_UDB10_11_MSK
Frame_Timer_TimerUDB_sCTRLReg_SyncCtl_ctrlreg__16BIT_PERIOD_PERIOD_REG EQU CYREG_B0_UDB10_11_MSK
Frame_Timer_TimerUDB_sCTRLReg_SyncCtl_ctrlreg__7__MASK EQU 0x80
Frame_Timer_TimerUDB_sCTRLReg_SyncCtl_ctrlreg__7__POS EQU 7
Frame_Timer_TimerUDB_sCTRLReg_SyncCtl_ctrlreg__CONTROL_AUX_CTL_REG EQU CYREG_B0_UDB10_ACTL
Frame_Timer_TimerUDB_sCTRLReg_SyncCtl_ctrlreg__CONTROL_REG EQU CYREG_B0_UDB10_CTL
Frame_Timer_TimerUDB_sCTRLReg_SyncCtl_ctrlreg__CONTROL_ST_REG EQU CYREG_B0_UDB10_ST_CTL
Frame_Timer_TimerUDB_sCTRLReg_SyncCtl_ctrlreg__COUNT_REG EQU CYREG_B0_UDB10_CTL
Frame_Timer_TimerUDB_sCTRLReg_SyncCtl_ctrlreg__COUNT_ST_REG EQU CYREG_B0_UDB10_ST_CTL
Frame_Timer_TimerUDB_sCTRLReg_SyncCtl_ctrlreg__MASK EQU 0x80
Frame_Timer_TimerUDB_sCTRLReg_SyncCtl_ctrlreg__MASK_CTL_AUX_CTL_REG EQU CYREG_B0_UDB10_MSK_ACTL
Frame_Timer_TimerUDB_sCTRLReg_SyncCtl_ctrlreg__PER_CTL_AUX_CTL_REG EQU CYREG_B0_UDB10_MSK_ACTL
Frame_Timer_TimerUDB_sCTRLReg_SyncCtl_ctrlreg__PERIOD_REG EQU CYREG_B0_UDB10_MSK
Frame_Timer_TimerUDB_sT16_timerdp_u0__16BIT_A0_REG EQU CYREG_B0_UDB10_11_A0
Frame_Timer_TimerUDB_sT16_timerdp_u0__16BIT_A1_REG EQU CYREG_B0_UDB10_11_A1
Frame_Timer_TimerUDB_sT16_timerdp_u0__16BIT_D0_REG EQU CYREG_B0_UDB10_11_D0
Frame_Timer_TimerUDB_sT16_timerdp_u0__16BIT_D1_REG EQU CYREG_B0_UDB10_11_D1
Frame_Timer_TimerUDB_sT16_timerdp_u0__16BIT_DP_AUX_CTL_REG EQU CYREG_B0_UDB10_11_ACTL
Frame_Timer_TimerUDB_sT16_timerdp_u0__16BIT_F0_REG EQU CYREG_B0_UDB10_11_F0
Frame_Timer_TimerUDB_sT16_timerdp_u0__16BIT_F1_REG EQU CYREG_B0_UDB10_11_F1
Frame_Timer_TimerUDB_sT16_timerdp_u0__A0_A1_REG EQU CYREG_B0_UDB10_A0_A1
Frame_Timer_TimerUDB_sT16_timerdp_u0__A0_REG EQU CYREG_B0_UDB10_A0
Frame_Timer_TimerUDB_sT16_timerdp_u0__A1_REG EQU CYREG_B0_UDB10_A1
Frame_Timer_TimerUDB_sT16_timerdp_u0__D0_D1_REG EQU CYREG_B0_UDB10_D0_D1
Frame_Timer_TimerUDB_sT16_timerdp_u0__D0_REG EQU CYREG_B0_UDB10_D0
Frame_Timer_TimerUDB_sT16_timerdp_u0__D1_REG EQU CYREG_B0_UDB10_D1
Frame_Timer_TimerUDB_sT16_timerdp_u0__DP_AUX_CTL_REG EQU CYREG_B0_UDB10_ACTL
Frame_Timer_TimerUDB_sT16_timerdp_u0__F0_F1_REG EQU CYREG_B0_UDB10_F0_F1
Frame_Timer_TimerUDB_sT16_timerdp_u0__F0_REG EQU CYREG_B0_UDB10_F0
Frame_Timer_TimerUDB_sT16_timerdp_u0__F1_REG EQU CYREG_B0_UDB10_F1
Frame_Timer_TimerUDB_sT16_timerdp_u0__MSK_DP_AUX_CTL_REG EQU CYREG_B0_UDB10_MSK_ACTL
Frame_Timer_TimerUDB_sT16_timerdp_u0__PER_DP_AUX_CTL_REG EQU CYREG_B0_UDB10_MSK_ACTL
Frame_Timer_TimerUDB_sT16_timerdp_u1__16BIT_A0_REG EQU CYREG_B0_UDB11_12_A0
Frame_Timer_TimerUDB_sT16_timerdp_u1__16BIT_A1_REG EQU CYREG_B0_UDB11_12_A1
Frame_Timer_TimerUDB_sT16_timerdp_u1__16BIT_D0_REG EQU CYREG_B0_UDB11_12_D0
Frame_Timer_TimerUDB_sT16_timerdp_u1__16BIT_D1_REG EQU CYREG_B0_UDB11_12_D1
Frame_Timer_TimerUDB_sT16_timerdp_u1__16BIT_DP_AUX_CTL_REG EQU CYREG_B0_UDB11_12_ACTL
Frame_Timer_TimerUDB_sT16_timerdp_u1__16BIT_F0_REG EQU CYREG_B0_UDB11_12_F0
Frame_Timer_TimerUDB_sT16_timerdp_u1__16BIT_F1_REG EQU CYREG_B0_UDB11_12_F1
Frame_Timer_TimerUDB_sT16_timerdp_u1__A0_A1_REG EQU CYREG_B0_UDB11_A0_A1
Frame_Timer_TimerUDB_sT16_timerdp_u1__A0_REG EQU CYREG_B0_UDB11_A0
Frame_Timer_TimerUDB_sT16_timerdp_u1__A1_REG EQU CYREG_B0_UDB11_A1
Frame_Timer_TimerUDB_sT16_timerdp_u1__D0_D1_REG EQU CYREG_B0_UDB11_D0_D1
Frame_Timer_TimerUDB_sT16_timerdp_u1__D0_REG EQU CYREG_B0_UDB11_D0
Frame_Timer_TimerUDB_sT16_timerdp_u1__D1_REG EQU CYREG_B0_UDB11_D1
Frame_Timer_TimerUDB_sT16_timerdp_u1__DP_AUX_CTL_REG EQU CYREG_B0_UDB11_ACTL
Frame_Timer_TimerUDB_sT16_timerdp_u1__F0_F1_REG EQU CYREG_B0_UDB11_F0_F1
Frame_Timer_TimerUDB_sT16_timerdp_u1__F0_REG EQU CYREG_B0_UDB11_F0
Frame_Timer_TimerUDB_sT16_timerdp_u1__F1_REG EQU CYREG_B0_UDB11_F1

/* Spi_LED_Chain */
Spi_LED_Chain_BSPIM_BitCounter__16BIT_CONTROL_AUX_CTL_REG EQU CYREG_B1_UDB08_09_ACTL
Spi_LED_Chain_BSPIM_BitCounter__16BIT_CONTROL_CONTROL_REG EQU CYREG_B1_UDB08_09_CTL
Spi_LED_Chain_BSPIM_BitCounter__16BIT_CONTROL_COUNT_REG EQU CYREG_B1_UDB08_09_CTL
Spi_LED_Chain_BSPIM_BitCounter__16BIT_COUNT_CONTROL_REG EQU CYREG_B1_UDB08_09_CTL
Spi_LED_Chain_BSPIM_BitCounter__16BIT_COUNT_COUNT_REG EQU CYREG_B1_UDB08_09_CTL
Spi_LED_Chain_BSPIM_BitCounter__16BIT_MASK_MASK_REG EQU CYREG_B1_UDB08_09_MSK
Spi_LED_Chain_BSPIM_BitCounter__16BIT_MASK_PERIOD_REG EQU CYREG_B1_UDB08_09_MSK
Spi_LED_Chain_BSPIM_BitCounter__16BIT_PERIOD_MASK_REG EQU CYREG_B1_UDB08_09_MSK
Spi_LED_Chain_BSPIM_BitCounter__16BIT_PERIOD_PERIOD_REG EQU CYREG_B1_UDB08_09_MSK
Spi_LED_Chain_BSPIM_BitCounter__CONTROL_AUX_CTL_REG EQU CYREG_B1_UDB08_ACTL
Spi_LED_Chain_BSPIM_BitCounter__CONTROL_REG EQU CYREG_B1_UDB08_CTL
Spi_LED_Chain_BSPIM_BitCounter__CONTROL_ST_REG EQU CYREG_B1_UDB08_ST_CTL
Spi_LED_Chain_BSPIM_BitCounter__COUNT_REG EQU CYREG_B1_UDB08_CTL
Spi_LED_Chain_BSPIM_BitCounter__COUNT_ST_REG EQU CYREG_B1_UDB08_ST_CTL
Spi_LED_Chain_BSPIM_BitCounter__MASK_CTL_AUX_CTL_REG EQU CYREG_B1_UDB08_MSK_ACTL
Spi_LED_Chain_BSPIM_BitCounter__PER_CTL_AUX_CTL_REG EQU CYREG_B1_UDB08_MSK_ACTL
Spi_LED_Chain_BSPIM_BitCounter__PERIOD_REG EQU CYREG_B1_UDB08_MSK
Spi_LED_Chain_BSPIM_BitCounter_ST__16BIT_STATUS_AUX_CTL_REG EQU CYREG_B1_UDB08_09_ACTL
Spi_LED_Chain_BSPIM_BitCounter_ST__16BIT_STATUS_REG EQU CYREG_B1_UDB08_09_ST
Spi_LED_Chain_BSPIM_BitCounter_ST__MASK_REG EQU CYREG_B1_UDB08_MSK
Spi_LED_Chain_BSPIM_BitCounter_ST__MASK_ST_AUX_CTL_REG EQU CYREG_B1_UDB08_MSK_ACTL
Spi_LED_Chain_BSPIM_BitCounter_ST__PER_ST_AUX_CTL_REG EQU CYREG_B1_UDB08_MSK_ACTL
Spi_LED_Chain_BSPIM_BitCounter_ST__STATUS_AUX_CTL_REG EQU CYREG_B1_UDB08_ACTL
Spi_LED_Chain_BSPIM_BitCounter_ST__STATUS_CNT_REG EQU CYREG_B1_UDB08_ST_CTL
Spi_LED_Chain_BSPIM_BitCounter_ST__STATUS_CONTROL_REG EQU CYREG_B1_UDB08_ST_CTL
Spi_LED_Chain_BSPIM_BitCounter_ST__STATUS_REG EQU CYREG_B1_UDB08_ST
Spi_LED_Chain_BSPIM_RxStsReg__16BIT_STATUS_AUX_CTL_REG EQU CYREG_B1_UDB09_10_ACTL
Spi_LED_Chain_BSPIM_RxStsReg__16BIT_STATUS_REG EQU CYREG_B1_UDB09_10_ST
Spi_LED_Chain_BSPIM_RxStsReg__4__MASK EQU 0x10
Spi_LED_Chain_BSPIM_RxStsReg__4__POS EQU 4
Spi_LED_Chain_BSPIM_RxStsReg__5__MASK EQU 0x20
Spi_LED_Chain_BSPIM_RxStsReg__5__POS EQU 5
Spi_LED_Chain_BSPIM_RxStsReg__6__MASK EQU 0x40
Spi_LED_Chain_BSPIM_RxStsReg__6__POS EQU 6
Spi_LED_Chain_BSPIM_RxStsReg__MASK EQU 0x70
Spi_LED_Chain_BSPIM_RxStsReg__MASK_REG EQU CYREG_B1_UDB09_MSK
Spi_LED_Chain_BSPIM_RxStsReg__STATUS_AUX_CTL_REG EQU CYREG_B1_UDB09_ACTL
Spi_LED_Chain_BSPIM_RxStsReg__STATUS_REG EQU CYREG_B1_UDB09_ST
Spi_LED_Chain_BSPIM_sR8_Dp_u0__16BIT_A0_REG EQU CYREG_B0_UDB09_10_A0
Spi_LED_Chain_BSPIM_sR8_Dp_u0__16BIT_A1_REG EQU CYREG_B0_UDB09_10_A1
Spi_LED_Chain_BSPIM_sR8_Dp_u0__16BIT_D0_REG EQU CYREG_B0_UDB09_10_D0
Spi_LED_Chain_BSPIM_sR8_Dp_u0__16BIT_D1_REG EQU CYREG_B0_UDB09_10_D1
Spi_LED_Chain_BSPIM_sR8_Dp_u0__16BIT_DP_AUX_CTL_REG EQU CYREG_B0_UDB09_10_ACTL
Spi_LED_Chain_BSPIM_sR8_Dp_u0__16BIT_F0_REG EQU CYREG_B0_UDB09_10_F0
Spi_LED_Chain_BSPIM_sR8_Dp_u0__16BIT_F1_REG EQU CYREG_B0_UDB09_10_F1
Spi_LED_Chain_BSPIM_sR8_Dp_u0__A0_A1_REG EQU CYREG_B0_UDB09_A0_A1
Spi_LED_Chain_BSPIM_sR8_Dp_u0__A0_REG EQU CYREG_B0_UDB09_A0
Spi_LED_Chain_BSPIM_sR8_Dp_u0__A1_REG EQU CYREG_B0_UDB09_A1
Spi_LED_Chain_BSPIM_sR8_Dp_u0__D0_D1_REG EQU CYREG_B0_UDB09_D0_D1
Spi_LED_Chain_BSPIM_sR8_Dp_u0__D0_REG EQU CYREG_B0_UDB09_D0
Spi_LED_Chain_BSPIM_sR8_Dp_u0__D1_REG EQU CYREG_B0_UDB09_D1
Spi_LED_Chain_BSPIM_sR8_Dp_u0__DP_AUX_CTL_REG EQU CYREG_B0_UDB09_ACTL
Spi_LED_Chain_BSPIM_sR8_Dp_u0__F0_F1_REG EQU CYREG_B0_UDB09_F0_F1
Spi_LED_Chain_BSPIM_sR8_Dp_u0__F0_REG EQU CYREG_B0_UDB09_F0
Spi_LED_Chain_BSPIM_sR8_Dp_u0__F1_REG EQU CYREG_B0_UDB09_F1
Spi_LED_Chain_BSPIM_TxStsReg__0__MASK EQU 0x01
Spi_LED_Chain_BSPIM_TxStsReg__0__POS EQU 0
Spi_LED_Chain_BSPIM_TxStsReg__1__MASK EQU 0x02
Spi_LED_Chain_BSPIM_TxStsReg__1__POS EQU 1
Spi_LED_Chain_BSPIM_TxStsReg__16BIT_STATUS_AUX_CTL_REG EQU CYREG_B0_UDB09_10_ACTL
Spi_LED_Chain_BSPIM_TxStsReg__16BIT_STATUS_REG EQU CYREG_B0_UDB09_10_ST
Spi_LED_Chain_BSPIM_TxStsReg__2__MASK EQU 0x04
Spi_LED_Chain_BSPIM_TxStsReg__2__POS EQU 2
Spi_LED_Chain_BSPIM_TxStsReg__3__MASK EQU 0x08
Spi_LED_Chain_BSPIM_TxStsReg__3__POS EQU 3
Spi_LED_Chain_BSPIM_TxStsReg__4__MASK EQU 0x10
Spi_LED_Chain_BSPIM_TxStsReg__4__POS EQU 4
Spi_LED_Chain_BSPIM_TxStsReg__MASK EQU 0x1F
Spi_LED_Chain_BSPIM_TxStsReg__MASK_REG EQU CYREG_B0_UDB09_MSK
Spi_LED_Chain_BSPIM_TxStsReg__STATUS_AUX_CTL_REG EQU CYREG_B0_UDB09_ACTL
Spi_LED_Chain_BSPIM_TxStsReg__STATUS_REG EQU CYREG_B0_UDB09_ST

/* isr_spi_tx_done */
isr_spi_tx_done__INTC_CLR_EN_REG EQU CYREG_NVIC_CLRENA0
isr_spi_tx_done__INTC_CLR_PD_REG EQU CYREG_NVIC_CLRPEND0
isr_spi_tx_done__INTC_MASK EQU 0x01
isr_spi_tx_done__INTC_NUMBER EQU 0
isr_spi_tx_done__INTC_PRIOR_NUM EQU 7
isr_spi_tx_done__INTC_PRIOR_REG EQU CYREG_NVIC_PRI_0
isr_spi_tx_done__INTC_SET_EN_REG EQU CYREG_NVIC_SETENA0
isr_spi_tx_done__INTC_SET_PD_REG EQU CYREG_NVIC_SETPEND0

/* Miscellaneous */
BCLK__BUS_CLK__HZ EQU 24000000
BCLK__BUS_CLK__KHZ EQU 24000
BCLK__BUS_CLK__MHZ EQU 24
CYDEV_CHIP_DIE_LEOPARD EQU 1
CYDEV_CHIP_DIE_PSOC4A EQU 26
CYDEV_CHIP_DIE_PSOC5LP EQU 2
CYDEV_CHIP_DIE_PSOC5TM EQU 3
CYDEV_CHIP_DIE_TMA4 EQU 4
CYDEV_CHIP_DIE_UNKNOWN EQU 0
CYDEV_CHIP_FAMILY_FM0P EQU 5
CYDEV_CHIP_FAMILY_FM3 EQU 6
CYDEV_CHIP_FAMILY_FM4 EQU 7
CYDEV_CHIP_FAMILY_PSOC3 EQU 1
CYDEV_CHIP_FAMILY_PSOC4 EQU 2
CYDEV_CHIP_FAMILY_PSOC5 EQU 3
CYDEV_CHIP_FAMILY_PSOC6 EQU 4
CYDEV_CHIP_FAMILY_UNKNOWN EQU 0
CYDEV_CHIP_FAMILY_USED EQU CYDEV_CHIP_FAMILY_PSOC5
CYDEV_CHIP_JTAG_ID EQU 0x2E161069
CYDEV_CHIP_MEMBER_3A EQU 1
CYDEV_CHIP_MEMBER_4A EQU 26
CYDEV_CHIP_MEMBER_4AA EQU 25
CYDEV_CHIP_MEMBER_4AB EQU 30
CYDEV_CHIP_MEMBER_4AC EQU 14
CYDEV_CHIP_MEMBER_4AD EQU 15
CYDEV_CHIP_MEMBER_4AE EQU 16
CYDEV_CHIP_MEMBER_4D EQU 20
CYDEV_CHIP_MEMBER_4E EQU 6
CYDEV_CHIP_MEMBER_4F EQU 27
CYDEV_CHIP_MEMBER_4G EQU 4
CYDEV_CHIP_MEMBER_4H EQU 24
CYDEV_CHIP_MEMBER_4I EQU 32
CYDEV_CHIP_MEMBER_4J EQU 21
CYDEV_CHIP_MEMBER_4K EQU 22
CYDEV_CHIP_MEMBER_4L EQU 31
CYDEV_CHIP_MEMBER_4M EQU 29
CYDEV_CHIP_MEMBER_4N EQU 11
CYDEV_CHIP_MEMBER_4O EQU 8
CYDEV_CHIP_MEMBER_4P EQU 28
CYDEV_CHIP_MEMBER_4Q EQU 17
CYDEV_CHIP_MEMBER_4R EQU 9
CYDEV_CHIP_MEMBER_4S EQU 12
CYDEV_CHIP_MEMBER_4T EQU 10
CYDEV_CHIP_MEMBER_4U EQU 5
CYDEV_CHIP_MEMBER_4V EQU 23
CYDEV_CHIP_MEMBER_4W EQU 13
CYDEV_CHIP_MEMBER_4X EQU 7
CYDEV_CHIP_MEMBER_4Y EQU 18
CYDEV_CHIP_MEMBER_4Z EQU 19
CYDEV_CHIP_MEMBER_5A EQU 3
CYDEV_CHIP_MEMBER_5B EQU 2
CYDEV_CHIP_MEMBER_6A EQU 33
CYDEV_CHIP_MEMBER_FM3 EQU 37
CYDEV_CHIP_MEMBER_FM4 EQU 38
CYDEV_CHIP_MEMBER_PDL_FM0P_TYPE1 EQU 34
CYDEV_CHIP_MEMBER_PDL_FM0P_TYPE2 EQU 35
CYDEV_CHIP_MEMBER_PDL_FM0P_TYPE3 EQU 36
CYDEV_CHIP_MEMBER_UNKNOWN EQU 0
CYDEV_CHIP_MEMBER_USED EQU CYDEV_CHIP_MEMBER_5B
CYDEV_CHIP_DIE_EXPECT EQU CYDEV_CHIP_MEMBER_USED
CYDEV_CHIP_DIE_ACTUAL EQU CYDEV_CHIP_DIE_EXPECT
CYDEV_CHIP_REV_LEOPARD_ES1 EQU 0
CYDEV_CHIP_REV_LEOPARD_ES2 EQU 1
CYDEV_CHIP_REV_LEOPARD_ES3 EQU 3
CYDEV_CHIP_REV_LEOPARD_PRODUCTION EQU 3
CYDEV_CHIP_REV_PSOC4A_ES0 EQU 17
CYDEV_CHIP_REV_PSOC4A_PRODUCTION EQU 17
CYDEV_CHIP_REV_PSOC5LP_ES0 EQU 0
CYDEV_CHIP_REV_PSOC5LP_PRODUCTION EQU 0
CYDEV_CHIP_REV_PSOC5TM_ES0 EQU 0
CYDEV_CHIP_REV_PSOC5TM_ES1 EQU 1
CYDEV_CHIP_REV_PSOC5TM_PRODUCTION EQU 1
CYDEV_CHIP_REV_TMA4_ES EQU 17
CYDEV_CHIP_REV_TMA4_ES2 EQU 33
CYDEV_CHIP_REV_TMA4_PRODUCTION EQU 17
CYDEV_CHIP_REVISION_3A_ES1 EQU 0
CYDEV_CHIP_REVISION_3A_ES2 EQU 1
CYDEV_CHIP_REVISION_3A_ES3 EQU 3
CYDEV_CHIP_REVISION_3A_PRODUCTION EQU 3
CYDEV_CHIP_REVISION_4A_ES0 EQU 17
CYDEV_CHIP_REVISION_4A_PRODUCTION EQU 17
CYDEV_CHIP_REVISION_4AA_PRODUCTION EQU 0
CYDEV_CHIP_REVISION_4AB_PRODUCTION EQU 0
CYDEV_CHIP_REVISION_4AC_PRODUCTION EQU 0
CYDEV_CHIP_REVISION_4AD_PRODUCTION EQU 0
CYDEV_CHIP_REVISION_4AE_PRODUCTION EQU 0
CYDEV_CHIP_REVISION_4D_PRODUCTION EQU 0
CYDEV_CHIP_REVISION_4E_CCG2_NO_USBPD EQU 0
CYDEV_CHIP_REVISION_4E_PRODUCTION EQU 0
CYDEV_CHIP_REVISION_4F_PRODUCTION EQU 0
CYDEV_CHIP_REVISION_4F_PRODUCTION_256DMA EQU 0
CYDEV_CHIP_REVISION_4F_PRODUCTION_256K EQU 0
CYDEV_CHIP_REVISION_4G_ES EQU 17
CYDEV_CHIP_REVISION_4G_ES2 EQU 33
CYDEV_CHIP_REVISION_4G_PRODUCTION EQU 17
CYDEV_CHIP_REVISION_4H_PRODUCTION EQU 0
CYDEV_CHIP_REVISION_4I_PRODUCTION EQU 0
CYDEV_CHIP_REVISION_4J_PRODUCTION EQU 0
CYDEV_CHIP_REVISION_4K_PRODUCTION EQU 0
CYDEV_CHIP_REVISION_4L_PRODUCTION EQU 0
CYDEV_CHIP_REVISION_4M_PRODUCTION EQU 0
CYDEV_CHIP_REVISION_4N_PRODUCTION EQU 0
CYDEV_CHIP_REVISION_4O_PRODUCTION EQU 0
CYDEV_CHIP_REVISION_4P_PRODUCTION EQU 0
CYDEV_CHIP_REVISION_4Q_PRODUCTION EQU 0
CYDEV_CHIP_REVISION_4R_PRODUCTION EQU 0
CYDEV_CHIP_REVISION_4S_PRODUCTION EQU 0
CYDEV_CHIP_REVISION_4T_PRODUCTION EQU 0
CYDEV_CHIP_REVISION_4U_PRODUCTION EQU 0
CYDEV_CHIP_REVISION_4V_PRODUCTION EQU 0
CYDEV_CHIP_REVISION_4W_PRODUCTION EQU 0
CYDEV_CHIP_REVISION_4X_PRODUCTION EQU 0
CYDEV_CHIP_REVISION_4Y_PRODUCTION EQU 0
CYDEV_CHIP_REVISION_4Z_PRODUCTION EQU 0
CYDEV_CHIP_REVISION_5A_ES0 EQU 0
CYDEV_CHIP_REVISION_5A_ES1 EQU 1
CYDEV_CHIP_REVISION_5A_PRODUCTION EQU 1
CYDEV_CHIP_REVISION_5B_ES0 EQU 0
CYDEV_CHIP_REVISION_5B_PRODUCTION EQU 0
CYDEV_CHIP_REVISION_6A_ES EQU 17
CYDEV_CHIP_REVISION_6A_NO_UDB EQU 33
CYDEV_CHIP_REVISION_6A_PRODUCTION EQU 33
CYDEV_CHIP_REVISION_FM3_PRODUCTION EQU 0
CYDEV_CHIP_REVISION_FM4_PRODUCTION EQU 0
CYDEV_CHIP_REVISION_PDL_FM0P_TYPE1_PRODUCTION EQU 0
CYDEV_CHIP_REVISION_PDL_FM0P_TYPE2_PRODUCTION EQU 0
CYDEV_CHIP_REVISION_PDL_FM0P_TYPE3_PRODUCTION EQU 0
CYDEV_CHIP_REVISION_USED EQU CYDEV_CHIP_REVISION_5B_PRODUCTION
CYDEV_CHIP_REV_EXPECT EQU CYDEV_CHIP_REVISION_USED
CYDEV_CONFIG_FASTBOOT_ENABLED EQU 1
CYDEV_CONFIG_UNUSED_IO_AllowButWarn EQU 0
CYDEV_CONFIG_UNUSED_IO EQU CYDEV_CONFIG_UNUSED_IO_AllowButWarn
CYDEV_CONFIG_UNUSED_IO_AllowWithInfo EQU 1
CYDEV_CONFIG_UNUSED_IO_Disallowed EQU 2
CYDEV_CONFIGURATION_COMPRESSED EQU 1
CYDEV_CONFIGURATION_DMA EQU 0
CYDEV_CONFIGURATION_ECC EQU 1
CYDEV_CONFIGURATION_IMOENABLED EQU CYDEV_CONFIG_FASTBOOT_ENABLED
CYDEV_CONFIGURATION_MODE_COMPRESSED EQU 0
CYDEV_CONFIGURATION_MODE EQU CYDEV_CONFIGURATION_MODE_COMPRESSED
CYDEV_CONFIGURATION_MODE_DMA EQU 2
CYDEV_CONFIGURATION_MODE_UNCOMPRESSED EQU 1
CYDEV_DEBUG_ENABLE_MASK EQU 0x20
CYDEV_DEBUG_ENABLE_REGISTER EQU CYREG_MLOGIC_DEBUG
CYDEV_DEBUGGING_DPS_Disable EQU 3
CYDEV_DEBUGGING_DPS_JTAG_4 EQU 1
CYDEV_DEBUGGING_DPS_JTAG_5 EQU 0
CYDEV_DEBUGGING_DPS_SWD EQU 2
CYDEV_DEBUGGING_DPS_SWD_SWV EQU 6
CYDEV_DEBUGGING_DPS EQU CYDEV_DEBUGGING_DPS_SWD_SWV
CYDEV_DEBUGGING_ENABLE EQU 1
CYDEV_DEBUGGING_XRES EQU 0
CYDEV_DMA_CHANNELS_AVAILABLE EQU 24
CYDEV_ECC_ENABLE EQU 0
CYDEV_HEAP_SIZE EQU 0x80
CYDEV_INSTRUCT_CACHE_ENABLED EQU 1
CYDEV_INTR_RISING EQU 0x00000001
CYDEV_IS_EXPORTING_CODE EQU 0
CYDEV_IS_IMPORTING_CODE EQU 0
CYDEV_PROJ_TYPE EQU 0
CYDEV_PROJ_TYPE_BOOTLOADER EQU 1
CYDEV_PROJ_TYPE_LAUNCHER EQU 5
CYDEV_PROJ_TYPE_LOADABLE EQU 2
CYDEV_PROJ_TYPE_LOADABLEANDBOOTLOADER EQU 4
CYDEV_PROJ_TYPE_MULTIAPPBOOTLOADER EQU 3
CYDEV_PROJ_TYPE_STANDARD EQU 0
CYDEV_PROTECTION_ENABLE EQU 0
CYDEV_STACK_SIZE EQU 0x0800
CYDEV_USE_BUNDLED_CMSIS EQU 1
CYDEV_VARIABLE_VDDA EQU 0
CYDEV_VDDA_MV EQU 5000
CYDEV_VDDD_MV EQU 5000
CYDEV_VDDIO0_MV EQU 5000
CYDEV_VDDIO1_MV EQU 5000
CYDEV_VDDIO2_MV EQU 5000
CYDEV_VDDIO3_MV EQU 5000
CYDEV_VIO0_MV EQU 5000
CYDEV_VIO1_MV EQU 5000
CYDEV_VIO2_MV EQU 5000
CYDEV_VIO3_MV EQU 5000
CYIPBLOCK_ARM_CM3_VERSION EQU 0
CYIPBLOCK_P3_ANAIF_VERSION EQU 0
CYIPBLOCK_P3_CAN_VERSION EQU 0
CYIPBLOCK_P3_CAPSENSE_VERSION EQU 0
CYIPBLOCK_P3_COMP_VERSION EQU 0
CYIPBLOCK_P3_DECIMATOR_VERSION EQU 0
CYIPBLOCK_P3_DFB_VERSION EQU 0
CYIPBLOCK_P3_DMA_VERSION EQU 0
CYIPBLOCK_P3_DRQ_VERSION EQU 0
CYIPBLOCK_P3_DSM_VERSION EQU 0
CYIPBLOCK_P3_EMIF_VERSION EQU 0
CYIPBLOCK_P3_I2C_VERSION EQU 0
CYIPBLOCK_P3_LCD_VERSION EQU 0
CYIPBLOCK_P3_LPF_VERSION EQU 0
CYIPBLOCK_P3_OPAMP_VERSION EQU 0
CYIPBLOCK_P3_PM_VERSION EQU 0
CYIPBLOCK_P3_SCCT_VERSION EQU 0
CYIPBLOCK_P3_TIMER_VERSION EQU 0
CYIPBLOCK_P3_USB_VERSION EQU 0
CYIPBLOCK_P3_VIDAC_VERSION EQU 0
CYIPBLOCK_P3_VREF_VERSION EQU 0
CYIPBLOCK_S8_GPIO_VERSION EQU 0
CYIPBLOCK_S8_IRQ_VERSION EQU 0
CYIPBLOCK_S8_SAR_VERSION EQU 0
CYIPBLOCK_S8_SIO_VERSION EQU 0
CYIPBLOCK_S8_UDB_VERSION EQU 0
DMA_CHANNELS_USED__MASK0 EQU 0x00000000
CYDEV_BOOTLOADER_ENABLE EQU 0

#endif /* INCLUDED_CYFITTERIAR_INC */
